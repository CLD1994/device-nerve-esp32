## components/cartfsm/Kconfig
```kconfig
menu "cartfsm - 模式机"

config CARTFSM_TEST_HOOKS
    bool "编入流程测试注入钩子"
    default n
    help
        编入 cartfsm_test_* 注入钩子（命令直注、编码器失联注入、
        丢步偏差注入、标定状态复位）。仅供独立测试工程（test/，
        经其 sdkconfig 默认开启）使用，流程测试用例
        （test_cartfsm_flow.c）依赖这些钩子。

        与历史 FLOW_TEST 选项不同：本项不自动运行任何测试，仅暴露
        注入接口。正式固件保持关闭。

config CARTFSM_TMC_TRACE
    bool "运行期TMC DRV_STATUS/GSTAT低频取证"
    default n
    select CARTFSM_STEP_LOSS_EVENTS
    help
        CPU0低优先级任务每轮依次读取DRV_STATUS/GSTAT后等待50ms；
        两次读取独立取锁和计时，不是同步快照。UART锁忙时
        不等待并记录busy。保存首次STEP_LOSS约2秒前窗、5秒后窗，
        停稳后TMCTRACE?以TMCT2导出。不会使能、写寄存器或改变保护。
        GSTAT含历史标志，读取可能改变其历史状态；不执行写1清除。
        成功取锁后的UART事务仍有等待和共享资源开销，不是无扰动保证。
        适用于当前无运行期settings写入口的应用；不得同时增加电流/
        细分写入任务而不重新审计锁等待及控制时序。开启与关闭需对照。

config CARTFSM_STEP_LOSS_EVENTS
    bool "STEP_LOSS 事件通知与运行身份"
    default n
    help
        每次成功 ENABLE 分配新运行 ID；每轮第一次 STEP_LOSS 发布 EVENT。
        仅使用小型事件邮箱，不分配轨迹缓冲、不额外读取编码器。
        通知由遥测任务发送，无 ACK/重放，不是可靠停机指令。

config CARTFSM_STEP_LOSS_DIAGNOSTICS
    bool "STEP_LOSS 快照及事件前后软件轨迹"
    default n
    select CARTFSM_STEP_LOSS_EVENTS
    help
        独立诊断模块；默认关闭。开启后保存触发快照、最多128条触发前
        和32条触发后记录（留样最小间隔5ms）。两个固定缓冲O(1)交换，
        不在监督路径格式化、发送UART、分配内存或另读SPI。
        仅停稳后用 STEPLOSS?/STEPTRACE? 读取。不是物理脉冲或运动证明。

config CARTFSM_STEP_LOSS_OBSERVE_ONLY
    bool "由上位机处置 STEP_LOSS（固件不因丢步停车）"
    default n
    select CARTFSM_STEP_LOSS_EVENTS
    help
        显式放弃固件 STEP_LOSS 停车：事件触发后保持 READY、目标速度、
        加速度与使能不变，由上位机决定继续、减速或停止。
        不依赖轨迹诊断；供电、编码器失效、软限位和命令看门狗不变。
        主机必须理解该模式，EVENT可能丢失，不能当作有保证的停机通知。

config CARTFSM_FOLLOWING_ERROR_WINDOW
    bool "使用连续增长窗口与独立硬限判定跟随误差"
    default n
    help
        开启后允许有限稳定偏差，以持续向外增长或独立硬限触发STEP_LOSS。
        不重置STEP累计位置。关闭保持原 STEP_LOSS_UM 立即触发判据。
        判定与处置解耦：是否停车由上面的上位机处置开关选择。

if CARTFSM_FOLLOWING_ERROR_WINDOW
config CARTFSM_FOLLOWING_ERROR_HARD_UM
    int "累计误差硬限（um）"
    range 1000 50000
    default 6000
config CARTFSM_FOLLOWING_ERROR_WINDOW_MS
    int "增长观察窗口（ms）"
    range 5 200
    default 50
config CARTFSM_FOLLOWING_ERROR_GROWTH_UM
    int "每窗口最小向外增长（um）"
    range 100 10000
    default 1000
config CARTFSM_FOLLOWING_ERROR_WINDOWS
    int "连续增长窗口数"
    range 2 10
    default 2
endif

endmenu
```

## components/settings/Kconfig
```kconfig
menu "settings - 启动电流请求"

config SETTINGS_STARTUP_RUN_CURRENT_OVERRIDE
    bool "启动时覆盖运行电流请求并持久保存到NVS"
    default n
    help
        每次启动在settings初始化后、设备初始化前检查运行电流请求。
        仅请求不同才写NVS；保持电流不变，保持请求大于目标时启动失败。
        关闭此选项不会恢复以前的NVS值。这里的请求不是实测相电流。

config SETTINGS_STARTUP_RUN_CURRENT_MA
    int "启动运行电流目标（mA RMS）"
    depends on SETTINGS_STARTUP_RUN_CURRENT_OVERRIDE
    range 1 2000
    default 1000

endmenu
```

## components/telemetry/Kconfig
```kconfig
menu "telemetry - 状态遥测"
config TELEMETRY_CART_DIAGNOSTICS
    bool "独立小车诊断流 CART_STATE1（最多50Hz）"
    default n
    help
        在双路STATE/VEL_VALID之外发送只依赖小车的快照。
        首帧后至少间隔20ms，失效变化也不突发；不新增编码器读取。
        有效帧携带设备组帧时间、样本时间和序列；无效帧不携带位置速度。
        增加协议UART负载；旧上位机必须先支持此帧再启用。
endmenu
```
