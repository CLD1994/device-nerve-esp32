## components/cartpower/Kconfig
```kconfig
menu "cartpower - 20V 供电验证"
    config CARTPOWER_SETTLE_MS
        int "请求后的最小稳定等待(ms)"
        range 1000 10000
        default 3000
    config CARTPOWER_TIMEOUT_MS
        int "从请求开始的验证超时(ms)"
        range 5000 30000
        default 10000
    config CARTPOWER_SAMPLE_MS
        int "供电采样间隔(ms)"
        range 20 500
        default 100
    config CARTPOWER_STABLE_SAMPLES
        int "连续有效样本数"
        range 3 10
        default 5
    config CARTPOWER_FRESH_MS
        int "样本有效期限(ms)"
        range 200 2000
        default 500
        help
            必须至少为两倍采样间隔加100ms。供电任务停滞时，
            FSM按此期限拒绝使能或停机；不是硬件保护响应保证。
endmenu
```

## components/magnetic_encoder/Kconfig
```kconfig
menu "magnetic_encoder - 磁编码器类别"

config MAGNETIC_ENCODER_AS5600
    bool "编入 AS5600 实现（I2C，12-bit，小车编码器）"
    default y

config MAGNETIC_ENCODER_MT6835
    bool "编入 MT6835 实现（SPI，21-bit，摆角编码器）"
    default y

config MAGNETIC_ENCODER_EXPERIMENT_2KHZ
    bool "实验：编码器任务采样目标 2 kHz（不提高 SPI 频率）"
    default n
    help
        使用 esp_timer 通知采样任务。过期通知不补采，任务优先级仍为3。
        速度窗为33点、名义16ms；这是试验目标，须真机测量验证。

config MAGNETIC_ENCODER_SAMPLING_STATS
    bool "输出编码器RAM采样统计（独立低优先级任务，每5秒）"
    default y if MAGNETIC_ENCODER_EXPERIMENT_2KHZ
    default n
    help
        统计每路成功间隔、任务通知延迟、读帧耗时、超期和错误。
        日志任务本身仍有调度和UART开销，性能比较须保持此选项一致。

endmenu
```

## experiments/step-frequency-isolated/firmware/sdkconfig.defaults
```kconfig
CONFIG_PARTITION_TABLE_CUSTOM_FILENAME="../../../partitions.csv"
CONFIG_STEP_ENGINE_TEST_HOOKS=n

CONFIG_ESP_MAIN_TASK_AFFINITY_CPU0=y
```
